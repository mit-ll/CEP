## cosim/drivers/cep_tests/Config.in
```kconfig
#************************************************************************
# Copyright 2021 Massachusetts Institute of Technology
#
# File Name:      Config.in
# Program:        Common Evaluation Platform (CEP)
# Description:    Buildroot Config.in for CEP Regression Suite
#************************************************************************

config BR2_PACKAGE_CEPREGRESSION
	bool "cepregression"
	help
	  Linux port of the CEP regression suite.

	  http://example.com
```

## cosim/drivers/linux/Config.in
```kconfig
#************************************************************************
# Copyright 2021 Massachusetts Institute of Technology
#
# File Name:      Config.in
# Program:        Common Evaluation Platform (CEP)
# Description:    Buildroot Config.in for CEP Regression Suite
#************************************************************************

config BR2_PACKAGE_CEP_DIAG
	bool "cep_diag"
	help
	  Linux port of the CEP diagnostic suite.

	  http://example.com
```

## cosim/drivers/linux/cryptopp/Config.in
```kconfig
#************************************************************************
# Copyright 2021 Massachusetts Institute of Technology
#
# File Name:      Config.in
# Program:        Common Evaluation Platform (CEP)
# Description:    Buildroot Config.in for CEP Regression Suite
#************************************************************************

config BR2_PACKAGE_CRYPTOPP
	bool "cryptopp"
	help
		An advanced C++ encryption library (AES, Twofish, TripleDES)
		
		http://www.cryptopp.com/
```

## sims/cep_cosim/drivers/cep_tests/Config.in
```kconfig
#************************************************************************
# Copyright 2022 Massachusets Institute of Technology
#
# File Name:      Config.in
# Program:        Common Evaluation Platform (CEP)
# Description:    Buildroot Config.in for CEP Regression Suite
#************************************************************************

config BR2_PACKAGE_CEPREGRESSION
	bool "cepregression"
	help
	  Linux port of the CEP regression suite.

	  http://example.com
```

## software/linux/gpiotest/Config.in
```kconfig
#***********************************************************************
# Copyright 2022 Massachusets Institute of Technology
# SPDX short identifier: BSD-2-Clause
#
# File Name:      Config.in
# Program:        Common Evaluation Platform (CEP)
# Description:    Buildroot configuration file for CEP linux application
# Notes:          
#************************************************************************

config BR2_PACKAGE_GPIOTEST
	bool "gpiotest"
	depends on BR2_PACKAGE_LIBGPIOD
	help
	  A linux port of the baremetal gpiotest program
```

## software/linux/helloworld/Config.in
```kconfig
#***********************************************************************
# Copyright 2022 Massachusets Institute of Technology
# SPDX short identifier: BSD-2-Clause
#
# File Name:      Config.in
# Program:        Common Evaluation Platform (CEP)
# Description:    Buildroot configuration file for CEP linux application
# Notes:          
#************************************************************************

config BR2_PACKAGE_HELLOWORLD
	bool "helloworld"
	help
	  A simple hello world program
```
